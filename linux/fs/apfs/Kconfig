## linux/fs/apfs/Kconfig
```kconfig
# SPDX-License-Identifier: GPL-2.0-only
config APFS_FS
	tristate "Apple File System (APFS) support (integration scaffolding)"
	depends on BLOCK
	depends on BROKEN
	help
	  This entry reserves the in-tree integration point for APFS while we
	  progressively move the out-of-tree driver into fs/apfs/ in small,
	  reviewable steps.

	  The current option is intentionally marked BROKEN and does not provide
	  mountable APFS support yet.

	  If unsure, say N.
```
